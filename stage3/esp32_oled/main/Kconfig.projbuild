## stage3/esp32_oled/main/Kconfig.projbuild
```kconfig
menu "Robot OLED terminal"

    config ROBOT_WIFI_SSID
        string "Wi-Fi hotspot SSID"
        default ""

    config ROBOT_WIFI_PASSWORD
        string "Wi-Fi hotspot password"
        default ""

    config ROBOT_STATUS_URL
        string "FastAPI display URL, e.g. http://192.168.1.10:8000/display/state"
        default ""

    config ROBOT_POLL_MS
        int "Status polling interval (ms)"
        range 500 10000
        default 1000

    config ROBOT_OLED_SDA_GPIO
        int "OLED SDA GPIO"
        default 21

    config ROBOT_OLED_SCL_GPIO
        int "OLED SCL GPIO"
        default 22

    config ROBOT_OLED_I2C_ADDRESS
        hex "OLED 7-bit I2C address"
        default 0x3C

endmenu
```
